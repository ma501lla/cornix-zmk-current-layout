## config/Kconfig
```kconfig
config CORNIX_LAYER9_LED_TEST
    bool "Cornix layer 9 LED test"
    depends on LED_STRIP
    default n
    help
      Lights the local Cornix WS2812 LEDs while layer 9 is active.
```

## config/boards/shields/cornix_layer9_led_test/Kconfig.shield
```kconfig
config SHIELD_CORNIX_LAYER9_LED_TEST
    def_bool $(shields_list_contains,cornix_layer9_led_test)

config CORNIX_LAYER9_LED_TEST
    bool "Cornix layer 9 LED test"
    depends on SHIELD_CORNIX_LAYER9_LED_TEST
    depends on LED_STRIP
    default y
    help
      Lights the local Cornix WS2812 LEDs while layer 9 is active.
```

## config/west.yml
```yaml
manifest:
  remotes:
    - name: zmkfirmware
      url-base: https://github.com/zmkfirmware
    - name: cornix-shield
      url-base: https://github.com/hitsmaxft
    - name: urob
      url-base: https://github.com/urob
  projects:
    - name: zmk
      remote: zmkfirmware
      revision: main
      import: app/west.yml
    - name: zmk-keyboard-cornix
      remote: cornix-shield
      revision: 12650a066238ffbb5176121b301f59de1ff346f7
    - name: zmk-helpers
      remote: urob
      revision: main
  self:
    path: config
```
